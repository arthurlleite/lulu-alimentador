## firmware/src/Kconfig.projbuild
```kconfig
menu "Alimentador - Rede e nuvem"

    config ALIM_PREFIXO_AP
        string "Prefixo do Wi-Fi de configuração"
        default "Alimentador"
        help
            Sem Wi-Fi salvo, a ESP32 cria a rede "<prefixo>-XXXX" (XXXX = final do MAC).
            Conecte o celular nela e a página de configuração abre sozinha.

    config ALIM_SENHA_AP
        string "Senha do Wi-Fi de configuração (vazio = aberta, ou 8+ caracteres)"
        default ""

    config ALIM_NOME_MDNS
        string "Nome na rede local (mDNS)"
        default "alimentador"
        help
            O app local fica em http://<nome>.local

    config ALIM_PORTAL_APOS_S
        int "Segundos sem conectar antes de reabrir a rede de configuração"
        range 15 600
        default 60

    config ALIM_MQTT_URI
        string "Broker MQTT (ESP32)"
        default "mqtts://broker.hivemq.com:8883"
        help
            Broker público e gratuito da HiveMQ, com TLS. O app web usa o mesmo broker
            via WebSocket seguro (wss://broker.hivemq.com:8884/mqtt).

    config ALIM_MQTT_PREFIXO
        string "Prefixo dos tópicos MQTT"
        default "alimentador"

    config ALIM_URL_APP
        string "Endereço do app web (GitHub Pages)"
        default "https://arthurlleite.github.io/lulu-alimentador/"

    config ALIM_FUSO
        string "Fuso horário (formato POSIX)"
        default "<-03>3"
        help
            Brasília = <-03>3. Manaus = <-04>4. Fernando de Noronha = <-02>2.

endmenu

menu "Alimentador - Pinos"

    config ALIM_GPIO_SERVO
        int "Servo (sinal PWM)"
        default 4 if IDF_TARGET_ESP32S3
        default 18

    config ALIM_GPIO_BOTAO
        int "Botão externo (para GND)"
        default 15 if IDF_TARGET_ESP32S3
        default 27

    config ALIM_GPIO_BUZZER
        int "Buzzer ativo"
        default 16 if IDF_TARGET_ESP32S3
        default 26

    config ALIM_GPIO_LED_R
        int "LED RGB - vermelho"
        default 17 if IDF_TARGET_ESP32S3
        default 21

    config ALIM_GPIO_LED_G
        int "LED RGB - verde"
        default 18 if IDF_TARGET_ESP32S3
        default 22

    config ALIM_GPIO_LED_B
        int "LED RGB - azul"
        default 8 if IDF_TARGET_ESP32S3
        default 23

    config ALIM_LED_ANODO_COMUM
        bool "LED RGB de anodo comum"
        default n

    config ALIM_SENSOR_NIVEL
        bool "Usar sensor ultrassônico HC-SR04 (nível de ração)"
        default n
        help
            O HC-SR04 não está na lista de peças da equipe. Ligue só se for usar um.

    config ALIM_GPIO_TRIG
        int "HC-SR04 TRIG"
        depends on ALIM_SENSOR_NIVEL
        default 5 if IDF_TARGET_ESP32S3
        default 25

    config ALIM_GPIO_ECHO
        int "HC-SR04 ECHO (via divisor de tensão 5 V -> 3,3 V)"
        depends on ALIM_SENSOR_NIVEL
        default 6 if IDF_TARGET_ESP32S3
        default 34

    config ALIM_DHT11
        bool "Usar DHT11 (temperatura e umidade do reservatório)"
        default n
        help
            O DHT11 não está na lista de peças da equipe. Ligue só se for usar um.

    config ALIM_GPIO_DHT
        int "DHT11 DATA"
        depends on ALIM_DHT11
        default 7 if IDF_TARGET_ESP32S3
        default 4

    config ALIM_SENSOR_SAIDA
        bool "Usar sensor na saída (confirma que a ração caiu)"
        default y
        help
            Módulo de sensor de chama (receptor IR com LM393) virado para a saída:
            cada grão que passa entre ele e a luz do outro lado gera um pulso no D0.
            Um sensor IR de obstáculo (FC-51) também serve.

    config ALIM_GPIO_SAIDA
        int "Sensor da saída (D0 do módulo)"
        depends on ALIM_SENSOR_SAIDA
        default 9 if IDF_TARGET_ESP32S3
        default 32

    config ALIM_SENSOR_CHAMA
        bool "Usar sensor de chama (alarme de fogo)"
        default y
        help
            Segundo módulo de sensor de chama, virado para fora. O D0 vai a 0 quando
            vê chama: o LED pisca vermelho, o buzzer toca e o app recebe o aviso.

    config ALIM_GPIO_CHAMA
        int "Sensor de chama (D0 do módulo)"
        depends on ALIM_SENSOR_CHAMA
        default 10 if IDF_TARGET_ESP32S3
        default 33

endmenu

menu "Alimentador - Mecânica"

    config ALIM_SERVO_MIN_US
        int "Pulso do servo em 0 graus (us)"
        default 500

    config ALIM_SERVO_MAX_US
        int "Pulso do servo em 180 graus (us)"
        default 2500

    config ALIM_ANGULO_FECHADO
        int "Ângulo fechado"
        range 0 180
        default 0

    config ALIM_ANGULO_ABERTO
        int "Ângulo aberto"
        range 0 180
        default 180

    config ALIM_TEMPO_ABERTO_MS
        int "Tempo aberto por porção (ms)"
        default 800
        help
            Mesmo valor do projeto original (MAX_ROTATE_MS). Calibre pesando a ração.

    config ALIM_TEMPO_FECHAR_MS
        int "Tempo para fechar entre porções (ms)"
        default 800

    config ALIM_NIVEL_BAIXO_PCT
        int "Alarme de ração baixa abaixo de (%)"
        range 0 100
        default 20

endmenu
```
